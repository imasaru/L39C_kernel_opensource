## arch/arm/mach-msm/lge/l4ii_cdma/Kconfig
```kconfig
config MACH_MSM7X27A_L4II_CDMA
    depends on ARCH_MSM7X27A
    depends on !MSM_STACKED_MEMORY
    select MACH_LGE
    bool "MSM7x27A L4II_CDMA"
    help
        Support for the LG Electronics MSM7x27A L4II_CDMA.

config MACH_MSM7X27A_L4II_CDMA_NO_DEBUG
    depends on MACH_MSM7X27A_L4II_CDMA
	default n
    bool "MSM7x27A L4II_CDMA DEBUG Option"
    help
        Support for the LG Electronics MSM7x27A L4II_CDMA.

config LGE_GPU_COMPOSITION_SUPPORT
	depends on MACH_MSM7X27A_L4II_CDMA
	default n
	bool "MSM7x27A L4II_CDMA GPU COMPOSTITION Option"
	help
		Support for the LG Electronics MSM7x27A L4II_CDMA.

config LGE_BATTERY_SUSPEND_RESUME
    depends on ARCH_MSM7X27A
    select MACH_LGE
    bool "MSM7x25A L4II_CDMA"
    help
         Support for the LG Electronics Power.

config LGE_DETECT_USB_CABLE_TYPE
    bool "Check the type of usb cable is connected to Handset"
    depends on MACH_LGE
    default n
    help
         Check the type of usb cable is connected to handset, like Factory USB or UART, normal
         charger and unknown cable.

config LGE_SUPPORT_AT_CMD
	bool "Support LGE AT_CMD system"
	default n
	depends on MACH_LGE
	help
		LGE AT_CMD Support

config LGE_ATS_ETA
	bool "Support LGE ATS ETA test"
	default n
	depends on LGE_SUPPORT_AT_CMD
	help
		Choose if ATS ETA test is required for RAT

config LGE_EMMC_SUPPORT
	bool "Support LGE eMMC related operations"
	default n
	depends on MACH_LGE
	help
	 eMMC read / write operations
```
